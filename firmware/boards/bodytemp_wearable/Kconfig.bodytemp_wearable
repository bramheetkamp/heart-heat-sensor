## firmware/boards/bodytemp_wearable/Kconfig.bodytemp_wearable
```kconfig
# ============================================================================
#  File:    Kconfig.bodytemp_wearable
#  Purpose: Hardware-Model-v2 board Kconfig anchor.
#  Author:  Daan
#  Date:    2026-06-14
#
#  Description:
#    Declares the board's Kconfig symbol. In Hardware Model v2 this file
#    replaces the old "Kconfig.board"; its name must match the board name from
#    board.yml. No options are added here for the PoC.
# ============================================================================

config BOARD_BODYTEMP_WEARABLE
	select SOC_NRF54L15_CPUAPP if BOARD_BODYTEMP_WEARABLE
```

## firmware/boards/bodytemp_wearable/Kconfig.defconfig
```kconfig
# ============================================================================
#  File:    Kconfig.defconfig
#  Purpose: Board-conditional Kconfig defaults for the custom PCB.
#  Author:  Daan
#  Date:    2026-06-14
#
#  Description:
#    Applied only when this board is the active target. Used for defaults that
#    must be expressed in Kconfig (rather than the plain *_defconfig), e.g.
#    overriding a default device name. Kept minimal for the PoC.
# ============================================================================

if BOARD_BODYTEMP_WEARABLE

config BT_DEVICE_NAME
	default "BodyTempPoC"

endif # BOARD_BODYTEMP_WEARABLE
```

## firmware/boards/bodytemp_wearable/board.yml
```yaml
# ============================================================================
#  File:    board.yml
#  Purpose: Hardware-Model-v2 board descriptor for the custom PCB.
#  Author:  Daan
#  Date:    2026-06-14
#
#  Description:
#    NCS v3.x uses Hardware Model v2: a board.yml names the board and its SoC
#    so west can resolve the build target "bodytemp_wearable/nrf54l15/cpuapp".
#    (This is the modern replacement for the old Kconfig.board file; the twister
#    metadata still lives in bodytemp_wearable.yaml.)
# ============================================================================

board:
  name: bodytemp_wearable
  full_name: BodyTempSensor Chest-Strap Wearable
  vendor: itsnotdaan
  socs:
    - name: nrf54l15
```

## firmware/boards/bodytemp_wearable/bodytemp_wearable_defconfig
```kconfig
# ============================================================================
#  File:    bodytemp_wearable_defconfig
#  Purpose: Board-level default Kconfig for the custom PCB.
#  Author:  Daan
#  Date:    2026-06-14
#
#  Description:
#    Defaults applied whenever this board is selected, before the app prj.conf.
#    Keep it to board-intrinsic settings (clocks, console, regulators); feature
#    enables belong in the app prj.conf so they are board-independent.
# ============================================================================

# Serial console + logging backend over the debug UART.
CONFIG_CONSOLE=y
CONFIG_UART_CONSOLE=y
CONFIG_SERIAL=y

# GPIO is always needed on this board (LEDs, buttons, EDA gate).
CONFIG_GPIO=y

# Use the internal RC for LF clock unless a 32.768 kHz crystal is fitted.
# (HFXO/Y1 is mandatory for the radio and is enabled by the SoC dtsi.)
CONFIG_CLOCK_CONTROL=y
```
